/* $Id: mb_tests.c,v 1.2 2021/06/02 08:22:35 iachang Exp $
 * $Source: /auto/diag/ngd-linux-rep/cvs/ng_diag/common/src/fugazi/mb_tests.c,v $
 *------------------------------------------------------------------
 *
 * mb_tests.c - M/B test wraps.
 *
 *
 * Copyright (c) 2008-2020 by Cisco Systems, Inc.
 * All rights reserved.
 *
 *------------------------------------------------------------------
 */
#include <stdio.h>
#include <stdlib.h>
#include <string.h>
#include <fcntl.h>
#include <unistd.h>

#include "endians.h"
#include "defs.h"
#include "types.h"
#include "nvsysvars.h"
#include "error.h"
#include "pcmap.h"
#include "strings.h"
#include "menu.h"
#include "common.h"
#include "cli_cmd.h"
#include "cross_platform.h"
#include "mb_tests.h"
#include "plat_defs.h"
#include "setjmps.h"
#include "platform_cpu.h"
#include "linux_usb_test.h"
#include "proto.h"
#include "diag_i211_test.h"
#include "diag_bcm57412_test.h"
#include "platform_fru.h"
#include "platform_i2c.h"
#include "linux_pciutils.h"
#include "dash_fpga.h"
#include "diag_bcm82757_test.h"
#include "diag_usb_test.h"
#include "diag_bcm54194_api.h"
#include "diag_bcm54194_test.h"
#include "diag_lasi_test.h"
#include "diag_sideband_test.h"


/*
 * Global variables
 */
fru_table_t platform_fru_table[];

static int emmc_tests(int);
static int m2_nvme_test(int); 
static int m2_usb_test(int); 
static int m2_combo_test(int); 

int pcie_lane_scan_test(void);
int check_skip_test(char *);  /* also used by platform_i2c.c */
type_t prt_skip_plugin(char *str);

extern uint pcie_config_read(uint32_t, uint32_t, uint16_t, uint, uint);
extern int get_pcie_cap_struct_ptr(uint32_t, uint16_t, int, uint);
extern int get_pcie_link_status(uint32_t, uint16_t, int, uint);
extern int get_pcie_link_cap(uint32_t, uint16_t, int, uint);
extern int fan_speed_test(void);

/* Fugazi mother board skippable plug-in items names.
 * Must match the name used in skip_test.txt generated by the script, and
 * Order in array must match enum MB_SKIP_ITEMS.
 * mb_skip_item_msg hold the skip message to be printed.
 */
char *mb_skip_item_name[] = { "M2", "USB0", "USB1" };
char mb_skip_item_msg[MB_SKIP_END][64];


/* FRU PID and Location Strings */
uchar mb_pid[] = "MB-PID";
uchar mb_loc[] = "MB";
uchar mb_emmc_loc[] = "MB/eMMC";
uchar mb_nvme_loc[] = "MB/NVME";


fru_table_t platform_fru_table[] = {
    {mb_pid,         mb_loc},
    {mb_pid,         mb_emmc_loc},
    { mb_pid,        mb_nvme_loc},

};

/*
 * Sub Menu used for "Main menu -> motherboard test"
 */
submenu_xtable_t mb_tests_submenu_table[] = {
    {"CPU core test",
    (PFT) cpu_core_test, FALSE,
    MF_CONTINUOUS | MF_DOGRP | MF_DOALL | MF_SHOW_ERRCOUNT,
    (type_t(*)())0, 0,
    (PFT) build_cpu_test_menu, FALSE},

    {"Main Memory test with cache on and ECC checking",
    (PFT) linux_memory_tester_with_ecc_check, FALSE,
    MF_CONTINUOUS | MF_DOGRP | MF_DOALL | MF_SHOW_ERRCOUNT,
    (type_t(*)())0, 0, (PFT) linux_memory_tester_with_ecc_check, TRUE},

    {"USB Type A test (need USB3.0 drive)",
   	(PFT)usb_tests,	0,
    MF_CONTINUOUS | MF_DOGRP | MF_DOALL | MF_SHOW_ERRCOUNT,
	(type_t(*)())0,		0,
	(PFT)0,	0},

    {"USB Type C test (need USB3.0 drive)",
   	(PFT)usb_tests,	1,
    MF_CONTINUOUS | MF_DOGRP | MF_DOALL | MF_SHOW_ERRCOUNT,
	(type_t(*)())0,		0,
	(PFT)0,	0},

    {"eMMC test",
    (PFT) emmc_tests , FALSE,
    MF_CONTINUOUS | MF_DOGRP | MF_DOALL | MF_SHOW_ERRCOUNT,
    (type_t(*)())0, 0,
    (PFT) emmc_tests, TRUE},

    {"M.2 slot NVMe/USB test",
    (PFT)m2_combo_test,  FALSE,  
    MF_CONTINUOUS | MF_DOGRP | MF_DOALL | MF_SHOW_ERRCOUNT,
    (type_t(*)())0,         0,
    (PFT)0,  0},

    {"PCIe lane scan test",
    (PFT)pcie_lane_scan_test,  FALSE,
    MF_CONTINUOUS | MF_DOGRP | MF_DOALL| MF_SHOW_ERRCOUNT,
    (type_t(*)())0,   0,
    (PFT) pcie_lane_scan_test, TRUE},

    {"I2C scan test",
    (PFT) fugazi_i2c_scan_test, FALSE,
    MF_CONTINUOUS | MF_DOGRP | MF_DOALL | MF_SHOW_ERRCOUNT,
    (type_t(*)())0, 0,
    (type_t(*)())0, 0},

    {"FPGA test",
    (PFT) dash_fpga_test, FALSE, 
    MF_CONTINUOUS | MF_DOGRP | MF_DOALL| MF_SHOW_ERRCOUNT,
    (type_t(*)())0,   0,
    (PFT) dash_fpga_test, TRUE},

    {"I211 Test",
    (PFT) i211_test, TRUE,
    MF_CONTINUOUS | MF_DOGRP | MF_DOALL| MF_SHOW_ERRCOUNT,
    (type_t(*)())0, 0, 
    (PFT) i211_test, 0},

    {"Boot flash test",
    (PFT) build_boot_flash_menu, FALSE,
    MF_CONTINUOUS | MF_DOGRP | MF_DOALL| MF_SHOW_ERRCOUNT,
    (type_t(*)())0, 0, 
    (PFT) build_boot_flash_menu, TRUE},

    {"SyncE PLL test",
    (PFT)synce_pll_test_menu, TRUE,
    MF_CONTINUOUS | MF_DOGRP | MF_DOALL | MF_SHOW_ERRCOUNT,
    (type_t(*)())0,   0,
    (type_t(*)())synce_pll_test_menu,   0},

    {"BCM57412 test",
    (PFT)ten_g_bcm57412_test, TRUE,
    MF_CONTINUOUS | MF_DOGRP | MF_DOALL | MF_SHOW_ERRCOUNT,
    (type_t(*)())0,   0,
    (type_t(*)())ten_g_bcm57412_test,   0},

    {"BCM82757 test",
    (PFT)fugazi_bcm82757_test, TRUE,
    MF_CONTINUOUS | MF_DOGRP | MF_DOALL | MF_SHOW_ERRCOUNT,
    (type_t(*)())0,   0,
    (type_t(*)())fugazi_bcm82757_test,   0},

    {"BCM54194 test",
    (PFT)ge_phy_bcm54194_test, TRUE,
    MF_CONTINUOUS | MF_DOGRP | MF_DOALL | MF_SHOW_ERRCOUNT,
    (type_t(*)())0,   0,
    (type_t(*)())ge_phy_bcm54194_test,   0},
    {"LASI test",
    (PFT)fugazi_lasi_test, TRUE,
    MF_CONTINUOUS | MF_DOGRP | MF_DOALL | MF_SHOW_ERRCOUNT,
    (type_t(*)())0,   0,
    (type_t(*)())fugazi_lasi_test,   0},
    {"Side Band test",
    (PFT)fugazi_sideband_test, TRUE,
    MF_CONTINUOUS | MF_DOGRP | MF_DOALL | MF_SHOW_ERRCOUNT,
    (type_t(*)())0,   0,
    (type_t(*)())fugazi_sideband_test,   0},
    {"Fan speed test",
    (PFT)fan_speed_test, TRUE,
    MF_CONTINUOUS | MF_DOGRP | MF_DOALL | MF_SHOW_ERRCOUNT,
    (type_t(*)())0,   0,
    (type_t(*)())fan_speed_test,   0},
};

#define MB_TESTS_SUBMENU_TABLE_SIZE (sizeof(mb_tests_submenu_table) / \
                                     sizeof(submenu_xtable_t))

/*
 * "Main menu -> motherboard test" primary & secondary submenu items (filled in from xtable)
 */
static mitem_t mb_tests_primary_items[MB_TESTS_SUBMENU_TABLE_SIZE +
                                      MAX_BASE_ITEMS];
static mitem_t mb_tests_secondary_items[MB_TESTS_SUBMENU_TABLE_SIZE +
                                        MAX_BASE_ITEMS];

menuinfo_t mb_subtest_menu = {
    "%s Subtest Menu",
    0,                          /* mtparam added by init_empty_menu */
    (PFT) show_endnote,         /* notes missing WICs in combos */
    0,                          /* use generic prompt */
    0,                          /* size (bumped by add_menu_item() */
    mb_tests_primary_items,
};

menuinfo_t *mb_submenup = &mb_subtest_menu;


static void display_no_reg (void)
{
    cterr_db_print("This item has no reg to display\n");
}

static void
display_env_err (void)
{
    //show_margins_x(0, CLI_MODE);
}

/*
 * Function: add_mb_item_skip_msg
 *
 * Description : Using the mitem_t feature. This function adds the
 * prt_skip_plugin to the mlfunc field of mitem_t to allow the
 * skipped plugin list to be appended after the mb menu items.
 *
 * Inputs: 
 *
 * Output: TRUE always
 */
int add_mb_item_skip_msg(submenu_xtable_t *px, int size, menuinfo_t **addr_submenup)
{
    MB_SKIP_ITEMS si;
    type_t (*x_pfunc)(), x_pparam;
    submenu_xtable_t *px_sav = px;
    int i, add_msg;
    mitem_t *pi;
    menuinfo_t *pm = *addr_submenup;

    for (si = M2_SK; si < MB_SKIP_END; si++) {
	x_pfunc = NULL;
	if (check_skip_test(mb_skip_item_name[si]) == TRUE) {
	    x_pparam = -1; /* init to a non valid number */
	    switch(si) {
	    case M2_SK:
		x_pfunc = (type_t (*)()) &m2_combo_test;
	        break;
	    case USB0_SK:
		x_pfunc = (type_t (*)()) &usb_tests;
		x_pparam = 0;
	        break;
	    case USB1_SK:
		x_pfunc = (type_t (*)()) &usb_tests;
		x_pparam = 1;
	        break;
	    default:
	        break;
	    }
	}

	if ((void *)x_pfunc != NULL) {
	    sprintf(mb_skip_item_msg[si], "...( %s ) skipped by user", mb_skip_item_name[si]);
	    add_msg = 0;
	    px = px_sav;
	    pi = pm->miptr + base_submenu_item_total;  /* pi is at  next item after base items */
	    for (i = 0; i < size; i++, px++, pi++) {
	      if ((void *)px->x_pfunc == (void *)x_pfunc) { /* function matched */
		    if ((void *)x_pfunc == (void *)&usb_tests) {
		        if (px->x_pparam == x_pparam) { /* check usb0 or usb1 */
			    add_msg = 1;
			}
		    }
		    else {
		        add_msg = 1;
		    }

		    if (add_msg) {
		        pi->mlfunc = &prt_skip_plugin;
			pi->mlparam = mb_skip_item_msg[si];
			break;
		    }
		}
	    }
	}
    }
    return (TRUE);
}

/**********************************************************************
 * Function: mb_tests()
 *
 * First build the primary & secondary submenus for the motherboard
 * diags based on the _xtable_ mb_tests_submenu_table.  If the given
 * arg is TRUE, execute all the tests in the menu flagged with
 * MF_DOALL, and return the result.  Otherwise, present the menu to the
 * user for interaction.
 *
 **********************************************************************
 */
int mb_tests (boolean mb_test_items_executed)
{
    int rc = FAILED;

    build_primary_submenu(mb_tests_submenu_table,
                          MB_TESTS_SUBMENU_TABLE_SIZE, "Motherboard",
                          &mb_submenup);

    build_secondary_submenu(mb_tests_submenu_table,
                            MB_TESTS_SUBMENU_TABLE_SIZE,
                            mb_tests_secondary_items);

    if (mb_test_items_executed) {
        do_all_menu_items(&mb_subtest_menu);
    } else {
        menu(&mb_subtest_menu, mb_tests_secondary_items, '\0');
    }

    return (rc);
}


/*Add extended error reporting functions here */
static void add_emmc_err_report (void)
{
    fru_table_offset = MB_EMMC;
    platform_fru_table[MB_EMMC].pid_string = mb_pid;
    platform_fru_table[MB_EMMC].location_string = mb_emmc_loc;
    cterr_add_component("MB", "eMMC");
    cterr_add_reg_dump((PFV)display_no_reg);
    cterr_add_env_dump((PFV)display_env_err);
    cterr_add_debug("Please check whether eMMC is plugged",
                    "Please try to use another eMMC");
}

static void add_nvme_err_report (void)
{
    fru_table_offset = MB_MSATA;
    platform_fru_table[MB_MSATA].pid_string = mb_pid;
    platform_fru_table[MB_MSATA].location_string = mb_nvme_loc;
    cterr_add_component("MB", "NVME");
    cterr_add_reg_dump((PFV)display_no_reg);
    cterr_add_env_dump((PFV)display_env_err);
    cterr_add_debug("Please check whether NVME slot is not vacant",
                    "Please try to use another NVME device");
}

/**********************************************************************
 * Function: emmc_tests
 *
 * Description : emmc r/w tests.
 *
 * Inputs: dummy
 *
 * Output: PASSED/FAILED
 **********************************************************************
 */
static int emmc_tests (int dummy)
{
    int rc = FAILED;
    char *tname = "emmc0";

    if (get_enhance_err_flag()) {
        add_emmc_err_report();
    }

    /* we only have one emmc */
    testname("%s access", tname);
    prpass(testpass, "%s, ", tname);

    /* testname is printed on usb_slot_tests */
    rc = fugazi_emmc_slot_tests(dummy);
    if (rc == FAILED) {
        cterr('f',0,"emmc0 test failed.");
    }

    return(rc);
}

/**********************************************************************
 * Function: check_skip_test
 *
 * Description : Check which tests need to be skipped.
 *
 * Inputs: item - Item name
 *
 * Output: TRUE/FALSE
 **********************************************************************
 */
int check_skip_test (char *item)
{
    char buf[128];
    char skip_all[] = "ALL";
    FILE *fp;
    char *result_file = "/fugazi-diag/skip_test.txt";

    fp = fopen(result_file, "r");
    if (fp == NULL) {
        return (FALSE);
    }

    while (!feof(fp)) {
        fgets(buf, sizeof(buf), fp);
        if ((strstr(buf, skip_all) != NULL) || (strstr(buf, item) != NULL)) {
            fclose(fp);
            return (TRUE);
        }
    }

    fclose(fp);
    return (FALSE);
}

/**********************************************************************
 * Function: m2_nvme_test
 *
 * Inputs: dummy
 *
 * Output: PASSED/FAILED
 **********************************************************************
 */
static int m2_nvme_test (int dummy) {

    int rc = FAILED;
    char *tname = "NVME read/write";
    char *nvme_dev = "/dev/nvme0n1";

    testname("%s access", tname);

    if (check_skip_test(mb_skip_item_name[M2_SK]) == TRUE) {
        prpass(testpass, "Test skipped by user. ");
        return(PASSED);
    }

    if (get_enhance_err_flag()) {
        add_nvme_err_report();
    }

    prpass(testpass, "%s, ", tname);

    rc = fugazi_sata_tests((uchar *)nvme_dev);
    if (rc == FAILED) {
        cterr('f',0, "M.2 NVME test failed.");
    }

    return(rc);
}

/**********************************************************************
 * Function: m2_usb_test
 *
 * Inputs: dummy
 *
 * Output: PASSED/FAILED
 **********************************************************************
 */
static int m2_usb_test (int dummy) {

    int rc = FAILED;
    char *tname = "NVME read/write";
    char *nvme_dev = "/dev/m2usb";

    testname("%s access", tname);

    if (check_skip_test(mb_skip_item_name[M2_SK]) == TRUE) {
        prpass(testpass, "Test skipped by user. ");
        return(PASSED);
    }

    if (get_enhance_err_flag()) {
        add_nvme_err_report();
    }

    prpass(testpass, "%s, ", tname);

    rc = fugazi_sata_tests((uchar *)nvme_dev);
    if (rc == FAILED) {
        cterr('f',0, "M.2 USB test failed.");
    }

    return(rc);
}

/*
 * Function: m2_combo_tests
 * This is just a wrapper to support the M.2 SATA and NVME modules
 *
 * Inputs: dummy
 *
 * Output: PASSED/FAILED
 */
static int m2_combo_test (int dummy) {

    char sys_cmd[256];
    char *temp_file="temp_file";
    FILE *fp;

    char *tname = "M.2 NVME or M.2 USB read/write";
    char *nvme_dev = "nvme0n1";
    /* pfix- Come back to fix this after udev rule change. Need to change this to use m2USB to correctly name the
     * /dev in kernel.
     */
    char *m2usb_dev = "m2usb";
    int word_count;
    uint rdval = 0;

    testname("%s access", tname);

    /* Check if test is skipped by user
     */
    if (check_skip_test(mb_skip_item_name[M2_SK]) == TRUE) {
        prpass(testpass, "Test skipped by user. ");
        return(PASSED);
    }

    /* check FPGA which M.2 module present */
    dash_fpga_reg_read(M2_MODULE_STS_CTL_REG, &rdval);
    if (rdval & M2_MODULE_PRESENT_BIT) {
        /* Is it NVME on PCIe bus? */
        if (rdval & M2_PCIE_PRESENT_BIT) {
	    /* NVME module exists */
	    prpass(testpass, "NVMe PCIe interface present bit is set \n");

	    sprintf(sys_cmd, "rm -f %s; ls /dev | grep %s | wc -w > %s;", temp_file, nvme_dev, temp_file);
	    system(sys_cmd);
	    fp = fopen(temp_file, "r");
	    if (fp == NULL) {
	        printf("Failed to open %s", temp_file);
		return (FAILED);
	    }
	    word_count = 0;
	    fscanf(fp, "%d", &word_count); /* Scan in the value */
	    fclose(fp);

	    if (word_count != 0) {
	        return(m2_nvme_test(0));
	    }
	    else {
	        prpass(testpass, "%s, ", tname);
		cterr('f',0, "NVME device not found in kernel /dev directory.");
		return (FAILED);
	    }
	}

        /* Is it Cisco M.2 USB ?*/
        if (rdval & M2_USB_2p0_PRESENT_BIT) {
	    /* Cisco M.2 USB module exists*/
	    prpass(testpass, "USB interface present bit is set \n");
	    sprintf(sys_cmd, "rm -f %s; ls /dev | grep %s | wc -w > %s;", temp_file, m2usb_dev, temp_file);
	    system(sys_cmd);

	    fp = fopen(temp_file, "r");
	    if (fp == NULL) {
	        printf("Failed to open %s", temp_file);
		return (FAILED);
	    }
	    word_count = 0;
	    fscanf(fp, "%d", &word_count); /* Scan in the value */
	    fclose(fp);

	    if (word_count != 0) {
	        return(m2_usb_test(0));
	    }
	    else {
	        prpass(testpass, "%s, ", tname);
		cterr('f',0, "M.2 USB device not found in kernel /dev directory.");
		return (FAILED);
	    }
	}

	prpass(testpass, "%s, ", tname);
	cterr('f',0, "M.2 module present bit is set but none of NVME and USB interface bit is set. ");
	return (FAILED);
    }
    else {
        cterr('f',0, "No M.2 NVME or M.2 USB device found in system.");
	return (FAILED);
    }
}

/**********************************************************************
 * Function: pcie_lane_scan_test
 *
 * Description : PCI interface scan/check
 *
 * Inputs: void
 *
 * Output: PASSED/FAILED
***********************************************************************
 */
int pcie_lane_scan_test (void)
{
    int ix, result = PASSED;
    uint32_t bus[5], reg_val[5], cap_val[5], sta_val[5], vid[5];
    uint32_t cap_s, sta_s, sta_w; /*cap_w*/
    char dev_name[8][20] = {"I211", "BCM57412", "BCM57412", "BCM57412", 
                            "BCM57412", "BCM57412", "BCM57412", "FPGA"};
    uint32_t dev_vid[8] = {PCIE_I211_VID, PCIE_BCM57412_VID, 
                           PCIE_BCM57412_VID, PCIE_BCM57412_VID, 
                           PCIE_BCM57412_VID, PCIE_BCM57412_VID, 
                           PCIE_BCM57412_VID, PCIE_FPGA_VID};
    uint32_t dev_did[8] = {PCIE_I211_DID, PCIE_BCM57412_DID, 
                           PCIE_BCM57412_DID, PCIE_BCM57412_DID, 
                           PCIE_BCM57412_DID, PCIE_BCM57412_DID, 
                           PCIE_BCM57412_DID, PCIE_FPGA_DID};
    uint32_t dev_width[8] = {PCI_EXP_LINK_STA_WID_1, PCI_EXP_LINK_STA_WID_4, 
                             PCI_EXP_LINK_STA_WID_4, PCI_EXP_LINK_STA_WID_2, 
                             PCI_EXP_LINK_STA_WID_2, PCI_EXP_LINK_STA_WID_2, 
                             PCI_EXP_LINK_STA_WID_2, PCI_EXP_LINK_STA_WID_1};
    uint32_t dev_pcie_bus[8] = {PCIE_I211_BUS, PCIE_BCM57412_DEV1_BUS, 
                                PCIE_BCM57412_DEV2_BUS, PCIE_BCM57412_DEV3_BUS, 
                                PCIE_BCM57412_DEV4_BUS, PCIE_BCM57412_DEV5_BUS, 
                                PCIE_BCM57412_DEV6_BUS, PCIE_FPGA_BUS};

    /* please note dev width is the same order as dev_vid and dev_did */

    char *tname = "PCI lane scan";
    testname("%s", tname);
    prpass(testpass, "%s, ", tname);

    for (ix = 0; ix < 8; ix++) {
        if ((NVRAM)->diagflag & D_VERBOSE) {
            printf("\n%s : testing vendor id 0x%x, device id 0x%x, %s\n", __FUNCTION__,
                         dev_vid[ix], dev_did[ix], dev_name[ix]);
        }

        /* Check following: I211, BCM57412, and FPGA */
        vid[ix] = get_pci_vendor_id(0, dev_pcie_bus[ix], 0, 0);
        if ((NVRAM)->diagflag & D_VERBOSE) {
            printf("\n%s : PCI Bus 0x%x ,Vendor ID  0x%x\n", __FUNCTION__, dev_pcie_bus[ix], vid[ix]);
        }
        if (vid[ix] != dev_vid[ix]) {
            cterr('f',0, "Unknown PCI bus number for device %04x:%04x", dev_vid[ix], dev_did[ix]);
            result = FAILED;  /* fail through */
        }
        bus[ix] = dev_pcie_bus[ix];

        prpass(testpass, "%s", dev_name[ix]);
        reg_val[ix] = get_pcie_cap_struct_ptr(bus[ix], PCI_DEV_0, PCI_FUN_0, PCI_CAP_PTR_OFFSET);
        if (reg_val[ix] == FAILED) {
            cterr('f',0, "Can't get PCI cap pointer");
            result = FAILED;  /* fail through */
        }

        cap_val[ix] = get_pcie_link_cap(bus[ix], PCI_DEV_0, PCI_FUN_0, reg_val[ix]);
        sta_val[ix] = get_pcie_link_status(bus[ix], PCI_DEV_0, PCI_FUN_0, reg_val[ix]);

        /* Speed - bit 0~3 */
        cap_s = cap_val[ix] & PCI_EXP_LINK_STA_SPD_MASK;
        sta_s = sta_val[ix] & PCI_EXP_LINK_STA_SPD_MASK;
        /* Width - bit 4~9 */
        /* cap_w = (cap_val[ix] & PCI_EXP_LINK_STA_WID_MASK) >> PCI_EXP_LINK_WID_SHIFT; */
        sta_w = (sta_val[ix] & PCI_EXP_LINK_STA_WID_MASK) >> PCI_EXP_LINK_WID_SHIFT;

        if ((cap_s == PCI_EXP_LINK_STA_SPD_2DOT5) && (sta_s == PCI_EXP_LINK_STA_SPD_2DOT5)) {
            prpass(testpass, "Link speed is 2.5G ");
        } else if ((cap_s == PCI_EXP_LINK_STA_SPD_5GT) && (sta_s == PCI_EXP_LINK_STA_SPD_5GT)) {
            prpass(testpass, "Link speed is 5G ");
        } else if ((cap_s == PCI_EXP_LINK_STA_SPD_8GT) && (sta_s == PCI_EXP_LINK_STA_SPD_8GT)) {
            prpass(testpass, "Link speed is 8G ");
        } else {
            cterr('f',0, "Link speed is not correct");
            result = FAILED;  /* fail through */
        }
        if ((NVRAM)->diagflag & D_VERBOSE) {
            printf("\n%s : Link speed 0x%x; width 0x%x\n", __FUNCTION__, cap_s, sta_w);
        }

        /* Fugazi FPGA x1, i211 x1, bcm57412 x4 x2 */
        if (sta_w == dev_width[ix]) {

            if (sta_w == PCI_EXP_LINK_STA_WID_1) {
                prpass(testpass, "Link width is x1 ");
            } else if (sta_w == PCI_EXP_LINK_STA_WID_2) {
                prpass(testpass, "Link width is x2 ");
            } else if (sta_w == PCI_EXP_LINK_STA_WID_4) {
                prpass(testpass, "Link width is x4 ");
            } else if (sta_w == PCI_EXP_LINK_STA_WID_8) {
                prpass(testpass, "Link width is x8 ");
            } else {
                cterr('f',0, "Link width is not x1 x2 x4 and x8, device id 0x%x vendor id 0x%x, device-%s",
                         dev_vid[ix], dev_did[ix], dev_name[ix]);
            }
        } else {
            cterr('f',0, "Link width is not correct, device id 0x%x vendor id 0x%x, device-%s",
                         dev_vid[ix], dev_did[ix], dev_name[ix]);
            result = FAILED; /* fail through for next device */
        }
    }
    if (result == FAILED) {
        prpass(testpass, "PCIe lane scan failed. ");
    } else {
        prpass(testpass, "PCIe lane scan success. ");
    }
    return (result);
}

/*
 * Function: prt_skip_plugin
 *
 * Description : This function will be called when the mb_tests menu item
 * is displayed to add the skipped plugin list after the menu title.
 *
 * Inputs: str - the skipped plugin list
 *
 * Output: TRUE always
 */
type_t prt_skip_plugin(char *str)
{
  printf("%s", str);
  return(TRUE);
}

/*-------------------------------------------------
 * $Log: mb_tests.c,v $
 * Revision 1.2  2021/06/02 08:22:35  iachang
 * CSCvo59196-33 : Merge Fugazi from ASR1K-main-branch to ISR main trunk
 *
 * Revision 1.1.8.3  2020/10/14 02:06:05  iachang
 * CSCvo59196-19 : Add Fan speed test in default test
 *
 * Revision 1.1.8.2  2020/08/26 02:37:49  iachang
 * Merge Fugazi code into main trunk
 *
 * Revision 1.1.6.21  2020/08/04 08:37:06  iachang
 * Update Copyright to 2020
 *
 * Revision 1.1.6.20  2020/04/24 07:13:16  iachang
 * The block device access test, used fix size to replace malloc_usable_size()
 *
 * Revision 1.1.6.19  2020/03/19 06:31:41  iachang
 * Support Fugazi Side Band test
 *
 * Revision 1.1.6.18  2020/03/18 06:51:44  iachang
 * Create independent file for LASI test
 *
 * Revision 1.1.6.17  2020/02/14 07:09:50  iachang
 * Fixed complie issue.
 *
 * Revision 1.1.6.16  2020/02/14 01:53:23  iachang
 * Modify the PCIe scan return string.
 *
 * Revision 1.1.6.15  2020/02/11 08:53:54  iachang
 * PCI scan test : HW would like test all PCIe buses, not stop on failure bus.
 *
 * Revision 1.1.6.14  2019/10/16 06:12:31  letsai
 * Modify file name
 *
 * Revision 1.1.6.13  2019/04/26 22:08:37  letsai
 * 1. Fixed FPGA board type unknow.
 * 2. Bump up to 0.0.3
 * 3. Remove m2sata related word.
 *
 * Revision 1.1.6.12  2019/04/26 00:56:24  letsai
 * Rename M.2 USB device and function name
 *
 * Revision 1.1.6.11  2019/04/25 23:25:27  letsai
 * 1. Remove eUSB test.
 * 2. Fixed bnxt_mdio r/w function to support both 1G and 10G phy.
 *
 * Revision 1.1.6.10  2019/04/11 22:32:29  letsai
 * 1. Replace the sign "*" to "-" when doing FPGA interrupt test
 * 2. Fix M.2 combo test when slot is empty.
 * 3. Make "check link utility" easy to use.
 * 4. When USB console detected, check the corresponding FPGA register bit.
 *
 * Revision 1.1.6.9  2019/04/10 21:26:58  letsai
 * 1. Support BCM54194 PHY SGMII Internal Loopback test.
 * 2. Return FAILED when M.2 module not present.
 * 3. Clean up code.
 *
 * Revision 1.1.6.8  2019/04/09 16:10:40  letsai
 * 1. Support all BCM54194 PHY (0~3) Register Test.
 * 2. Let utilities can dump each phy registers.
 * 3. Check link status for each phy and each port(upstream and downstream).
 *
 * Revision 1.1.6.7  2019/04/06 01:36:14  letsai
 * 1. Remove unused functions and files.
 * 2. Fix BCM54194 SFP External loopback test.
 * 3. Fix BCM54194 Register test.
 * 4. Fix Voltage Margin Utility.
 * 5. Add function to show system information.
 *
 * Revision 1.1.6.6  2019/03/30 00:56:02  letsai
 * 1. Add USB console detect utility.
 * 2. Modify FAN utility.
 * 3. Remove unused items.
 * 4. Fix BCM54194 phy register test.
 *
 * Revision 1.1.6.5  2019/03/28 19:00:34  letsai
 * 1. Modify FPGA interrupt test and utility.
 * 2. Modify I2C address of PSU2.
 * 3. Clean up code.
 * 4. Merge M.2 NVME and M.2 USB tests to combo test.
 *
 * Revision 1.1.6.4  2019/03/16 01:56:51  iachang
 * Bring up PCIe lane scan test.
 *
 * Revision 1.1.6.3  2019/03/14 22:59:59  iachang
 * Bring up PCIe lane scan
 *
 * Revision 1.1.6.2  2019/03/14 03:48:36  letsai
 * Initial check in.
 *
 *
 *
 *
 * $Endlog$
 */
